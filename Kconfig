## Kconfig
```kconfig
menu "NanoRTC Configuration"

    config NANORTC_FEATURE_DATACHANNEL
        bool "Enable DataChannel (SCTP+DCEP)"
        default y
        help
            Enable WebRTC DataChannel support. Compiles SCTP, DCEP,
            and CRC-32c modules. Disable to save ~2500 lines of code
            for media-only devices.

    config NANORTC_FEATURE_DC_RELIABLE
        bool "Enable reliable DataChannel delivery"
        default y
        depends on NANORTC_FEATURE_DATACHANNEL
        help
            Enable DATA chunk retransmission (RTO backoff, SACK-driven).
            When OFF, all DataChannels are fire-and-forget (unreliable).

    config NANORTC_FEATURE_DC_ORDERED
        bool "Enable ordered DataChannel delivery"
        default y
        depends on NANORTC_FEATURE_DATACHANNEL
        help
            Enable SSN-based ordered delivery. When OFF, all DATA chunks
            are sent with the Unordered flag set.

    config NANORTC_FEATURE_AUDIO
        bool "Enable audio (RTP/SRTP/Jitter)"
        default n
        help
            Enable audio media transport. Compiles RTP, RTCP, SRTP,
            and jitter buffer modules.

    config NANORTC_FEATURE_VIDEO
        bool "Enable video (RTP/SRTP/BWE)"
        default n
        help
            Enable video media transport. Compiles RTP, RTCP, SRTP,
            and bandwidth estimation modules. H.264 is always offered
            when video is enabled; H.265 is opt-in (see below).

    config NANORTC_FEATURE_H265
        bool "Enable H.265/HEVC video codec (RFC 7798)"
        default n
        depends on NANORTC_FEATURE_VIDEO
        help
            Enable H.265/HEVC RTP packetization (RFC 7798). Adds ~11 KB
            of code on top of NANORTC_FEATURE_VIDEO. Disabled by default;
            only H.264 is offered when off.

    config NANORTC_FEATURE_IPV6
        bool "Enable IPv6 address support"
        default y
        help
            Enable IPv6 candidate parsing and SDP generation.
            Disable on IPv4-only targets to save code size.

    config NANORTC_FEATURE_TURN
        bool "Enable TURN relay client (RFC 5766)"
        default y
        help
            Enable TURN relay support for NAT traversal. LAN-only
            deployments can disable to save ~700B RAM + ~13KB code.

    config NANORTC_MAX_DATACHANNELS
        int "Maximum number of DataChannels"
        default 2
        range 1 64
        depends on NANORTC_FEATURE_DATACHANNEL
        help
            Maximum number of DataChannels that can be open simultaneously.
            Each channel uses approximately 40 bytes of RAM. IoT-grade
            default 2 covers one signaling + one media channel.

    config NANORTC_MAX_ICE_CANDIDATES
        int "Maximum ICE candidates"
        default 4
        range 1 16
        help
            Maximum number of ICE candidates stored per connection.

    config NANORTC_ICE_MAX_CHECKS
        int "Maximum ICE connectivity checks"
        default 25
        range 5 100
        help
            Number of STUN Binding Requests sent before declaring ICE failure.
            See RFC 8445.

    config NANORTC_ICE_CHECK_INTERVAL_MS
        int "ICE check pacing interval (ms)"
        default 50
        range 20 500
        help
            Interval in milliseconds between STUN connectivity checks.
            RFC 8445 recommends at least 20ms.

    config NANORTC_DTLS_BUF_SIZE
        int "DTLS I/O buffer size (bytes)"
        default 1536
        range 256 16384
        help
            Size of the DTLS read/write scratch buffer. Must accommodate
            the largest DTLS record expected. 1536 covers a 1500-byte
            Ethernet MTU with TLS record overhead; raise to 2048 if your
            peer fragments ClientHello across larger records.

    config NANORTC_SDP_BUF_SIZE
        int "SDP parsing buffer size (bytes)"
        default 1024
        range 512 16384
        help
            Size of the buffer used for SDP offer/answer parsing. 1024 fits
            single-track / small-offer IoT SDPs; raise to 2048 for multi-
            track offers or when exchanging with browsers that emit many
            codecs and extmap lines.

    config NANORTC_SCTP_SEND_BUF_SIZE
        int "SCTP send buffer size (bytes)"
        default 2048
        range 1024 262144
        depends on NANORTC_FEATURE_DATACHANNEL
        help
            Size of the SCTP send buffer for outgoing DataChannel messages.
            2048 fits IoT-style signaling / small control frames; raise
            to 4096 or higher for high-throughput DataChannel use cases.

    config NANORTC_SCTP_RECV_BUF_SIZE
        int "SCTP receive buffer size (bytes)"
        default 2048
        range 1024 262144
        depends on NANORTC_FEATURE_DATACHANNEL
        help
            Size of the SCTP receive buffer for incoming DataChannel messages.
            2048 fits IoT signaling loads; raise for high-throughput peers.

    config NANORTC_OUT_QUEUE_SIZE
        int "Output event queue depth"
        default 16 if NANORTC_FEATURE_VIDEO
        default 8
        range 4 256
        help
            Depth of the output event ring buffer. Must be a power of 2.
            8 suffices for DataChannel-only or audio-only builds. 16 covers
            ≤480p H.264 FU-A bursts; override to 32 for 720p/1080p cameras.

    config NANORTC_MEDIA_BUF_SIZE
        int "Media scratch buffer size (bytes)"
        default 1232
        range 1230 4096
        depends on NANORTC_FEATURE_AUDIO || NANORTC_FEATURE_VIDEO
        help
            Scratch buffer for RTP/SRTP pack/unpack. Also sets the per-slot
            size of the packet ring buffer. Must hold:
              RTP header (12) + TWCC extension (8) +
              payload up to NANORTC_VIDEO_MTU (1200) +
              SRTP auth tag (10) = 1230 bytes minimum.
            Default 1232 leaves 2 bytes headroom; raise to 1280 to reserve
            room for additional RTP header extensions, 1500 for jumbo MTU.

    config NANORTC_VIDEO_NAL_BUF_SIZE
        int "H.264 NAL reassembly buffer size (bytes)"
        default 8192
        range 4096 131072
        depends on NANORTC_FEATURE_VIDEO
        help
            Maximum reassembled NAL unit size for the FU-A depacketizer.
            8192 covers typical 480p H.264 IDR NALs (4-8 KB). Raise to
            16384 for larger 480p streams, 32768/65536 for 720p/1080p
            with bigger keyframes.

    config NANORTC_JITTER_SLOTS
        int "Jitter buffer slots"
        default 16
        range 8 256
        depends on NANORTC_FEATURE_AUDIO
        help
            Number of slots in the jitter buffer. Each slot holds one
            RTP packet. 16 slots at 20ms pacing = 320ms reorder window,
            enough for typical Wi-Fi / cellular paths. Raise to 32 for
            high-jitter satellite or long-haul links.

    config NANORTC_JITTER_SLOT_DATA_SIZE
        int "Jitter buffer slot data size (bytes)"
        default 160
        range 160 1500
        depends on NANORTC_FEATURE_AUDIO
        help
            Maximum RTP payload per jitter slot. 160 covers Opus 20ms
            @64kbps and G.711. Raise to 320 for Opus @128kbps, 640 for
            Opus @510kbps (very uncommon on IoT targets).

    config NANORTC_SCTP_RECV_GAP_BUF_SIZE
        int "SCTP out-of-order gap buffer size (bytes)"
        default 2048
        range 1024 65536
        depends on NANORTC_FEATURE_DATACHANNEL
        help
            Scratch holding payloads of out-of-order DATA chunks awaiting
            gap fill. 2048 covers LAN / Wi-Fi reorder depth; raise for
            high-loss paths.

    config NANORTC_SCTP_MAX_SEND_QUEUE
        int "SCTP pending DATA chunk queue depth"
        default 4
        range 2 64
        depends on NANORTC_FEATURE_DATACHANNEL
        help
            Depth of the outbound DATA chunk queue awaiting SACK.
            4 fits IoT signaling bursts; raise for bulk transfer.

    config NANORTC_SCTP_MAX_RECV_GAP
        int "SCTP maximum out-of-order gap blocks"
        default 4
        range 2 32
        depends on NANORTC_FEATURE_DATACHANNEL
        help
            Maximum gap-ack blocks tracked in a SACK. 4 covers typical
            LAN reorder; raise for high-loss paths.

    config NANORTC_LOG_LEVEL
        int "Maximum compile-time log level"
        default 1
        range 0 4
        help
            0=ERROR 1=WARN 2=INFO 3=DEBUG 4=TRACE. Messages above this
            level are removed at compile time. Production firmware
            typically uses 0 or 1; raise to 3 or 4 for field debugging.

    config NANORTC_LOG_NO_LOC
        bool "Strip __FILE__/__LINE__/__func__ from log callsites"
        default y
        help
            When enabled, each LOG callsite stops embedding source-location
            pointers, saving 1-2 KB of .rodata on ESP32. Disable if your
            log sink needs file/line/function metadata.

endmenu
```

## examples/esp32_audio/main/Kconfig.projbuild
```kconfig
menu "ESP32 Audio Example"

    config EXAMPLE_UDP_PORT
        int "Local UDP port for WebRTC"
        default 9999
        range 1024 65535
        help
            UDP port for STUN/DTLS/RTP traffic.

    choice EXAMPLE_AUDIO_CODEC
        prompt "Audio codec"
        default EXAMPLE_AUDIO_CODEC_PCMU
        config EXAMPLE_AUDIO_CODEC_OPUS
            bool "Opus (48kHz mono)"
        config EXAMPLE_AUDIO_CODEC_PCMA
            bool "G.711 A-law / PCMA (8kHz mono)"
        config EXAMPLE_AUDIO_CODEC_PCMU
            bool "G.711 mu-law / PCMU (8kHz mono)"
    endchoice

    config EXAMPLE_MUSIC_BPM
        int "Music tempo (BPM)"
        default 120
        range 60 200
        help
            Tempo of the generated melody in beats per minute.

endmenu
```

## examples/esp32_audio/sdkconfig.defaults
```kconfig
# nanortc ESP32 Audio example — default SDK configuration
#
# Custom partition table (factory = 1.75 MB for Opus builds)
CONFIG_PARTITION_TABLE_CUSTOM=y
CONFIG_PARTITION_TABLE_CUSTOM_FILENAME="partitions.csv"

# mbedTLS DTLS support
CONFIG_MBEDTLS_SSL_PROTO_DTLS=y
CONFIG_MBEDTLS_SSL_DTLS_SRTP=y
CONFIG_MBEDTLS_KEY_EXCHANGE_ECDHE_ECDSA=y
CONFIG_MBEDTLS_ECDSA_C=y
CONFIG_MBEDTLS_ECP_DP_SECP256R1_ENABLED=y
CONFIG_MBEDTLS_SSL_MAX_CONTENT_LEN=4096
CONFIG_MBEDTLS_X509_CREATE_C=y
CONFIG_MBEDTLS_X509_CRT_WRITE_C=y
CONFIG_MBEDTLS_PEM_WRITE_C=y

# lwIP
CONFIG_LWIP_MAX_SOCKETS=8
CONFIG_LWIP_SO_RCVTIMEO=y
CONFIG_LWIP_SO_REUSE=y

# nanortc features: Audio only (no DataChannel)
CONFIG_NANORTC_FEATURE_AUDIO=y
# DataChannel off by default (audio-only device)
# CONFIG_NANORTC_FEATURE_DATACHANNEL is not set

# Output queue (audio needs fewer slots than video)
CONFIG_NANORTC_OUT_QUEUE_SIZE=8

# Jitter buffer: sendonly example doesn't receive audio, minimize slots
CONFIG_NANORTC_JITTER_SLOTS=8
```

## examples/esp32_camera/boards/esp32_p4_nano/sdkconfig.defaults.board
```kconfig
#
# Camera Sensor: OV5647 via MIPI CSI
#
CONFIG_CAMERA_OV5647=y
CONFIG_CAMERA_OV5647_MIPI_RAW8_800X800_50FPS=y
CONFIG_CAMERA_OV5647_MIPI_RAW10_1920X1080_30FPS=y
CONFIG_CAMERA_OV5647_MIPI_DEFAULT_FMT_RAW10_1920X1080_30FPS=y
CONFIG_CAMERA_OV5647_MIPI_IF_FORMAT_INDEX_DEFAULT=3
CONFIG_CAMERA_OV5647_CSI_LINESYNC_ENABLE=y
CONFIG_CAMERA_OV5647_DEFAULT_IPA_JSON_CONFIGURATION_FILE=y
```

## examples/esp32_camera/sdkconfig.defaults.esp32p4
```kconfig
# ESP32-P4 specific configuration
#
# Chip revision: P4 Nano board is rev v1.0 (v5.5 defaults to v3.1+)
CONFIG_ESP32P4_SELECTS_REV_LESS_V3=y
CONFIG_ESP32P4_REV_MIN_100=y

# Flash
CONFIG_FLASHMODE_QIO=y
CONFIG_ESPTOOLPY_FLASHSIZE_8MB=y

# SPIRAM (required for camera frame buffers and H264 encoder)
CONFIG_SPIRAM=y
CONFIG_SPIRAM_SPEED_200M=y
CONFIG_SPIRAM_TRY_ALLOCATE_WIFI_LWIP=y
CONFIG_MBEDTLS_EXTERNAL_MEM_ALLOC=y

# Network: Ethernet (ESP32-P4 has internal EMAC, no WiFi)
CONFIG_EXAMPLE_CONNECT_ETHERNET=y
CONFIG_EXAMPLE_CONNECT_WIFI=n
CONFIG_EXAMPLE_USE_INTERNAL_ETHERNET=y
CONFIG_EXAMPLE_ETH_PHY_IP101=y
CONFIG_EXAMPLE_ETH_MDC_GPIO=31
CONFIG_EXAMPLE_ETH_MDIO_GPIO=52
CONFIG_EXAMPLE_ETH_PHY_RST_GPIO=-1
CONFIG_EXAMPLE_ETH_PHY_ADDR=1

# Override Kconfig defaults (1280x960) to use OV5647 max resolution
CONFIG_EXAMPLE_VIDEO_WIDTH=1920
CONFIG_EXAMPLE_VIDEO_HEIGHT=1080

# esp_video: only CSI camera device, no JPEG/H264 codec devices
CONFIG_ESP_VIDEO_ENABLE_HW_JPEG_VIDEO_DEVICE=n
CONFIG_ESP_VIDEO_ENABLE_HW_H264_VIDEO_DEVICE=n

# Required for CSI/ISP drivers on ESP32-P4
CONFIG_IDF_EXPERIMENTAL_FEATURES=y
```

## examples/esp32_datachannel/main/Kconfig.projbuild
```kconfig
menu "ESP32 DataChannel Example"

    config EXAMPLE_UDP_PORT
        int "Local UDP port for WebRTC"
        default 9999
        range 1024 65535
        help
            UDP port for STUN/DTLS/SCTP traffic.

    config EXAMPLE_WEBSERVER_STACK_SIZE
        int "HTTP server task stack (bytes)"
        default 4096
        range 2048 16384
        help
            Stack size of the esp_http_server task that runs the signaling
            POST /offer handler. 4096 fits the default offer_handler plus
            nanortc_init on the handler path; raise if you add heavy work
            in your offer_handler (deep TLS libraries, extra malloc, etc.).

endmenu
```

## examples/esp32_datachannel/sdkconfig.defaults
```kconfig
# nanortc ESP32 DataChannel example — default SDK configuration
#
# mbedTLS DTLS support
CONFIG_MBEDTLS_SSL_PROTO_DTLS=y
CONFIG_MBEDTLS_KEY_EXCHANGE_ECDHE_ECDSA=y
CONFIG_MBEDTLS_ECDSA_C=y
CONFIG_MBEDTLS_ECP_DP_SECP256R1_ENABLED=y
CONFIG_MBEDTLS_SSL_MAX_CONTENT_LEN=4096
CONFIG_MBEDTLS_X509_CREATE_C=y
CONFIG_MBEDTLS_X509_CRT_WRITE_C=y
CONFIG_MBEDTLS_PEM_WRITE_C=y

# lwIP
CONFIG_LWIP_MAX_SOCKETS=8
CONFIG_LWIP_SO_RCVTIMEO=y
CONFIG_LWIP_SO_REUSE=y

# nanortc features (DataChannel only for this example)
CONFIG_NANORTC_FEATURE_DATACHANNEL=y
CONFIG_NANORTC_FEATURE_DC_RELIABLE=y
CONFIG_NANORTC_FEATURE_DC_ORDERED=y
```

## examples/esp32_video/main/Kconfig.projbuild
```kconfig
menu "ESP32 Video Example"

    config EXAMPLE_UDP_PORT
        int "Local UDP port for WebRTC"
        default 9999
        range 1024 65535
        help
            UDP port for STUN/DTLS/RTP traffic.

    config EXAMPLE_VIDEO_FPS
        int "Video frame rate (fps)"
        default 25
        range 1 60
        help
            Playback speed for H.264 sample frames from embedded flash blob.

    config EXAMPLE_WEBSERVER_STACK_SIZE
        int "HTTP server task stack (bytes)"
        default 4096
        range 2048 16384
        help
            Stack size of the esp_http_server task that runs the signaling
            POST /offer handler. 4096 fits the default offer_handler plus
            nanortc_init on the handler path; raise if you add heavy work
            in your offer_handler (deep TLS libraries, extra malloc, etc.).

endmenu
```
