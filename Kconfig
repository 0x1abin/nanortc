## examples/esp32_video/sdkconfig.defaults
```kconfig
# nanortc ESP32 A/V example — default SDK configuration
#
# Custom partition table (factory ~3.6 MB) — needs >= 4 MB flash.
# Default IDF flash size is 2 MB, so partition-table generation fails
# without an explicit FLASHSIZE here. Boards with larger flash can
# override via menuconfig.
CONFIG_ESPTOOLPY_FLASHSIZE_4MB=y
CONFIG_ESPTOOLPY_FLASHSIZE="4MB"
CONFIG_PARTITION_TABLE_CUSTOM=y
CONFIG_PARTITION_TABLE_CUSTOM_FILENAME="partitions.csv"

# mbedTLS DTLS support
CONFIG_MBEDTLS_SSL_PROTO_DTLS=y
CONFIG_MBEDTLS_SSL_DTLS_SRTP=y
CONFIG_MBEDTLS_KEY_EXCHANGE_ECDHE_ECDSA=y
CONFIG_MBEDTLS_ECDSA_C=y
CONFIG_MBEDTLS_ECP_DP_SECP256R1_ENABLED=y
CONFIG_MBEDTLS_SSL_MAX_CONTENT_LEN=4096
CONFIG_MBEDTLS_X509_CREATE_C=y
CONFIG_MBEDTLS_X509_CRT_WRITE_C=y
CONFIG_MBEDTLS_PEM_WRITE_C=y

# lwIP
CONFIG_LWIP_MAX_SOCKETS=8
CONFIG_LWIP_SO_RCVTIMEO=y
CONFIG_LWIP_SO_REUSE=y

# Task stack (nanortc_t is large, needs generous stack)
CONFIG_HTTPD_MAX_REQ_HDR_LEN=1024

# nanortc features: Audio + Video (no DataChannel)
CONFIG_NANORTC_FEATURE_VIDEO=y
CONFIG_NANORTC_FEATURE_AUDIO=y
# CONFIG_NANORTC_FEATURE_DATACHANNEL is not set

# Output queue (video FU-A fragmentation needs more slots)
CONFIG_NANORTC_OUT_QUEUE_SIZE=16

# Media buffer must hold: RTP header (12) + MTU payload (1200) + SRTP tag (10)
CONFIG_NANORTC_MEDIA_BUF_SIZE=1280
```

## scripts/esp32-measure/sdkconfig.defaults
```kconfig
# nanortc size measurement — base config (target-agnostic)
#
# mbedTLS DTLS support (required by nanortc)
CONFIG_MBEDTLS_SSL_PROTO_DTLS=y
CONFIG_MBEDTLS_KEY_EXCHANGE_ECDHE_ECDSA=y
CONFIG_MBEDTLS_ECDSA_C=y
CONFIG_MBEDTLS_ECP_DP_SECP256R1_ENABLED=y
CONFIG_MBEDTLS_SSL_MAX_CONTENT_LEN=4096
CONFIG_MBEDTLS_X509_CREATE_C=y
CONFIG_MBEDTLS_X509_CRT_WRITE_C=y
CONFIG_MBEDTLS_PEM_WRITE_C=y

# Reduce stack (we don't actually run)
CONFIG_ESP_MAIN_TASK_STACK_SIZE=4096
```
